# file: DMP_driver.ioc
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Mcu.Family=STM32F4
Mcu.Name=STM32F405RGTx
Mcu.Package=LQFP64
NVIC.PriorityGroup=NVIC_PRIORITYGROUP_4
NVIC.TIM2_IRQn=true\:0\:0\:false\:false\:true\:true
PA4.Signal=COMP_DAC1_group
ProjectManager.HeapSize=0x200
ProjectManager.StackSize=0x400
ProjectManager.TargetToolchain=MDK-ARM V5
RCC.48MHZClocksFreq_Value=50000000
RCC.AHBFreq_Value=100000000
RCC.APB1CLKDivider=RCC_HCLK_DIV4
RCC.APB1Freq_Value=25000000
RCC.APB1TimFreq_Value=50000000
RCC.APB2CLKDivider=RCC_HCLK_DIV4
RCC.APB2Freq_Value=25000000
RCC.APB2TimFreq_Value=50000000
RCC.CortexFreq_Value=100000000
RCC.HCLKFreq_Value=100000000
RCC.HSE_VALUE=25000000
RCC.HSI_VALUE=16000000
RCC.LSE_VALUE=32768
RCC.PLLM=8
RCC.PLLN=100
RCC.SYSCLKFreq_VALUE=100000000
RCC.SYSCLKSource=RCC_SYSCLKSOURCE_PLLCLK
RCC.VCOOutputFreq_Value=200000000
SH.COMP_DAC1_group.0=DAC_OUT1,DAC_OUT1
TIM2.Period=10-1
TIM2.Prescaler=50000-1
VP_TIM2_VS_ClockSourceINT.Mode=Internal
board=custom

// file: Src/main.c
/* USER CODE BEGIN Header */
/**
  ******************************************************************************
  * @file           : main.c
  * @brief          : Main program body
  ******************************************************************************
  ** This notice applies to any and all portions of this file
  * that are not between comment pairs USER CODE BEGIN and
  * USER CODE END. Other portions of this file, whether
  * inserted by the user or by software development tools
  * are owned by their respective copyright owners.
  *
  * COPYRIGHT(c) 2019 STMicroelectronics
  *
  * Redistribution and use in source and binary forms, with or without modification,
  * are permitted provided that the following conditions are met:
  *   1. Redistributions of source code must retain the above copyright notice,
  *      this list of conditions and the following disclaimer.
  *   2. Redistributions in binary form must reproduce the above copyright notice,
  *      this list of conditions and the following disclaimer in the documentation
  *      and/or other materials provided with the distribution.
  *   3. Neither the name of STMicroelectronics nor the names of its contributors
  *      may be used to endorse or promote products derived from this software
  *      without specific prior written permission.
  *
  * THIS SOFTWARE IS PROVIDED BY THE COPYRIGHT HOLDERS AND CONTRIBUTORS "AS IS"
  * AND ANY EXPRESS OR IMPLIED WARRANTIES, INCLUDING, BUT NOT LIMITED TO, THE
  * IMPLIED WARRANTIES OF MERCHANTABILITY AND FITNESS FOR A PARTICULAR PURPOSE ARE
  * DISCLAIMED. IN NO EVENT SHALL THE COPYRIGHT HOLDER OR CONTRIBUTORS BE LIABLE
  * FOR ANY DIRECT, INDIRECT, INCIDENTAL, SPECIAL, EXEMPLARY, OR CONSEQUENTIAL
  * DAMAGES (INCLUDING, BUT NOT LIMITED TO, PROCUREMENT OF SUBSTITUTE GOODS OR
  * SERVICES; LOSS OF USE, DATA, OR PROFITS; OR BUSINESS INTERRUPTION) HOWEVER
  * CAUSED AND ON ANY THEORY OF LIABILITY, WHETHER IN CONTRACT, STRICT LIABILITY,
  * OR TORT (INCLUDING NEGLIGENCE OR OTHERWISE) ARISING IN ANY WAY OUT OF THE USE
  * OF THIS SOFTWARE, EVEN IF ADVISED OF THE POSSIBILITY OF SUCH DAMAGE.
  *
  ******************************************************************************
  */
/* USER CODE END Header */

#include "main.h"
#include "dac.h"
#include "tim.h"
#include "gpio.h"

/* USER CODE BEGIN Includes */
#include "dmp.h"
/* USER CODE END Includes */

/* USER CODE BEGIN PD */
// for Debug
	float32_t value_state;
	float32_t value_s;
	struct struct_dmp DMP;
	// state variables
	float32_t x[2], xd[2], s[1], sd[1];
/* USER CODE END PD */

void SystemClock_Config(void);

int main(void)
{
  /* USER CODE BEGIN 1 */
	// init DMP parameters
	// function_approximators
	DMP.centers_[0]=-55.2314; DMP.centers_[1]=-54.2134; DMP.centers_[2]=-53.2134; DMP.centers_[3]=-52.2134; DMP.centers_[4]=-51.2134;
	DMP.centers_[5]=-50.2134; DMP.centers_[6]=-49.2134; DMP.centers_[7]=-48.2134; DMP.centers_[8]=-47.2134; DMP.centers_[9]=-46.2134;
	DMP.centers_[10]=-45.2134; DMP.centers_[11]=-44.2134; DMP.centers_[12]=-43.2134; DMP.centers_[13]=-42.2134; DMP.centers_[14]=-41.2134;
	DMP.centers_[15]=-40.2134; DMP.centers_[16]=-39.2134; DMP.centers_[17]=-38.2134; DMP.centers_[18]=-37.2134; DMP.centers_[19]=-36.2134;
	DMP.d = -0.0181;
	DMP.h = 0.5;

	//DMP.widths_[0]=0.050645; DMP.widths_[1]=0.050645; DMP.widths_[2]=0.050645; DMP.widths_[3]=0.050645; DMP.widths_[4]=0.050645;
	//DMP.widths_[5]=0.050645; DMP.widths_[6]=0.050645; DMP.widths_[7]=0.050645; DMP.widths_[8]=0.050645; DMP.widths_[9]=0.050645;

	//DMP.slopes_[0]=158.926305; DMP.slopes_[1]=-1323.948000; DMP.slopes_[2]=-1411.688617; DMP.slopes_[3]=19.631479; DMP.slopes_[4]=273.245066;
	//DMP.slopes_[5]=265.394108; DMP.slopes_[6]=223.404527; DMP.slopes_[7]=183.825189; DMP.slopes_[8]=151.934707; DMP.slopes_[9]=121.071957;

	//DMP.offsets_[0]=26.418002; DMP.offsets_[1]=120.373333; DMP.offsets_[2]=102.306187; DMP.offsets_[3]=-286.973893; DMP.offsets_[4]=-381.651993;
	//DMP.offsets_[5]=-376.964855; DMP.offsets_[6]=-351.133944; DMP.offsets_[7]=-322.549734; DMP.offsets_[8]=-296.053101; DMP.offsets_[9]=-267.312239;

	DMP.weight_[0]=-4.9104; DMP.weight_[1]=-4.8633; DMP.weight_[2]=-4.7688; DMP.weight_[3]=-4.6083; DMP.weight_[4]=-4.3687;
	DMP.weight_[5]=-4.0286; DMP.weight_[6]=-3.5579; DMP.weight_[7]=-2.9235; DMP.weight_[8]=-2.1047; DMP.weight_[9]=-1.1385;
	DMP.weight_[10]=-0.2091; DMP.weight_[11]=0.4113; DMP.weight_[12]=0.6699; DMP.weight_[13]=0.7232; DMP.weight_[14]=0.6908;
	DMP.weight_[15]=0.6181; DMP.weight_[16]=0.5161; DMP.weight_[17]=0.3867; DMP.weight_[18]=0.2536; DMP.weight_[19]=0.1523;

	// init DMP state
	DMP.dt = 0.01;
	DMP.tau_ = 1;
	DMP.initial_state_ = -0.747175;
	DMP.attractor_state_ = 0.745890;
	DMP.basis_number_ = 20;

	// init spring_damping
	DMP.alpha_ = 0.05;
//	DMP.spring_constant_ = 5.0;
//	DMP.damping_coefficient_ = 10.0;
//	DMP.mass_ = 1.0;
	DMP.K_ = 5.0;
	DMP.D_ = 10.0;

	// init state variables
	x[0] = 0; //x1
	x[1] = DMP.initial_state_;  //x2
	s[0] = 1;
	sd[0] = -4/8.43;

  /* USER CODE END 1 */

  /* MCU Configuration--------------------------------------------------------*/

  /* Reset of all peripherals, Initializes the Flash interface and the Systick. */
  HAL_Init();

  /* Configure the system clock */
  SystemClock_Config();

  /* Initialize all configured peripherals */
  MX_GPIO_Init();
  MX_DAC_Init();
  MX_TIM2_Init();

  /* USER CODE BEGIN 2 */
  //	int stamp_number;

	DMP.stamp_number = 844;//DMP.tau_/DMP.dt;
  //for(int i=0; i<DMP.stamp_number; i++)
	//{
	//	IntegrateStep_phase(&DMP, s, sd);
	//	IntegrateStep_DMP(&DMP, s, x, xd);
		//USER_ADC_SetValue(&hdac, DAC_CHANNEL_2,x[1]);
		//value_state = x[1];
		//value_s = s[0];
	//}
  /* USER CODE END 2 */

  HAL_TIM_Base_Start_IT(&htim2);
  /* Infinite loop */
  while (1)
  {

  }
}

void SystemClock_Config(void)
{
  RCC_OscInitTypeDef RCC_OscInitStruct = {0};
  RCC_ClkInitTypeDef RCC_ClkInitStruct = {0};

  /**Configure the main internal regulator output voltage
  */
  __HAL_RCC_PWR_CLK_ENABLE();
  __HAL_PWR_VOLTAGESCALING_CONFIG(PWR_REGULATOR_VOLTAGE_SCALE1);
  /**Initializes the CPU, AHB and APB busses clocks
  */
  RCC_OscInitStruct.OscillatorType = RCC_OSCILLATORTYPE_HSI;
  RCC_OscInitStruct.HSIState = RCC_HSI_ON;
  RCC_OscInitStruct.HSICalibrationValue = RCC_HSICALIBRATION_DEFAULT;
  RCC_OscInitStruct.PLL.PLLState = RCC_PLL_ON;
  RCC_OscInitStruct.PLL.PLLSource = RCC_PLLSOURCE_HSI;
  RCC_OscInitStruct.PLL.PLLM = 8;
  RCC_OscInitStruct.PLL.PLLN = 100;
  RCC_OscInitStruct.PLL.PLLP = RCC_PLLP_DIV2;
  RCC_OscInitStruct.PLL.PLLQ = 4;
  if (HAL_RCC_OscConfig(&RCC_OscInitStruct) != HAL_OK)
  {
    Error_Handler();
  }
  /**Initializes the CPU, AHB and APB busses clocks
  */
  RCC_ClkInitStruct.ClockType = RCC_CLOCKTYPE_HCLK|RCC_CLOCKTYPE_SYSCLK
                              |RCC_CLOCKTYPE_PCLK1|RCC_CLOCKTYPE_PCLK2;
  RCC_ClkInitStruct.SYSCLKSource = RCC_SYSCLKSOURCE_PLLCLK;
  RCC_ClkInitStruct.AHBCLKDivider = RCC_SYSCLK_DIV1;
  RCC_ClkInitStruct.APB1CLKDivider = RCC_HCLK_DIV4;
  RCC_ClkInitStruct.APB2CLKDivider = RCC_HCLK_DIV4;

  if (HAL_RCC_ClockConfig(&RCC_ClkInitStruct, FLASH_LATENCY_3) != HAL_OK)
  {
    Error_Handler();
  }
}

void Error_Handler(void)
{
}

/************************ (C) COPYRIGHT STMicroelectronics *****END OF FILE****/
